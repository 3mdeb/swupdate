## bootloader/Config.in
```kconfig
#
# For a description of the syntax of this configuration file,
# see scripts/kbuild/config-language.txt.
#

menu "Bootloader selection"

choice
	prompt "Select used bootloader"

	config BOOTLOADER_UBOOT
		bool "U-Boot bootloader"
		depends on HAVE_LIBUBOOTENV
		depends on HAVE_ZLIB
		help
		  Select U-Boot as used bootloader

	comment "uboot support needs libubootenv, libz"
		depends on !HAVE_ZLIB

	config BOOTLOADER_GRUB
		bool "GRUB Bootloader"
		help
		  Select GRUB as used bootloader
endchoice

config GRUBENV_PATH
	string "GRUB Environment block file path"
	depends on BOOTLOADER_GRUB
	default "/boot/efi/EFI/BOOT/grub/grubenv"
	help
	  Provide path to GRUB environment block file

config UBOOT_FWENV
	string "U-Boot Environment Configuration file"
	depends on BOOTLOADER_UBOOT
	default "/etc/fw_env.config"
	help
	  This is the file described in U-Boot documentation
	  in the tools directory. It tells where the U-Boot
	  environment is saved.

endmenu
```
